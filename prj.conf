## CMakeLists.txt
```
# SPDX-License-Identifier: Apache-2.0

cmake_minimum_required(VERSION 3.20.0)
find_package(Zephyr REQUIRED HINTS $ENV{ZEPHYR_BASE})
project(zephyr_nfc_hce)

target_sources(app PRIVATE
    src/main.c
    # src/pn532.c
)
```

## west.yml
```
manifest:

  defaults:
    remote: zephyrproject

  remotes:
    - name: zephyrproject
      url-base: https://github.com/zephyrproject-rtos

  projects:
    - name: zephyr
      repo-path: zephyr
      revision: v4.3.0
      path: zephyr
      import:
        path-prefix: dependencies
        name-allowlist:
          - cmsis_6
          - hal_stm32

  self:
    path: application
```

## prj.conf
```kconfig
# Logging
CONFIG_LOG=y
CONFIG_LOG_INFO_COLOR_GREEN=y
CONFIG_LOG_DBG_COLOR_BLUE=y
CONFIG_LOG_OUTPUT_FORMAT_TIME_TIMESTAMP=y
CONFIG_LOG_OUTPUT_FORMAT_DATE_TIMESTAMP=y

# UART
CONFIG_SERIAL=y
CONFIG_UART_INTERRUPT_DRIVEN=y

# Shell
CONFIG_SHELL=y
CONFIG_KERNEL_SHELL=y

# Debugging
CONFIG_DEBUG=y
CONFIG_DEBUG_THREAD_INFO=y
CONFIG_NO_OPTIMIZATIONS=y
CONFIG_SIZE_OPTIMIZATIONS=n
CONFIG_THREAD_STACK_INFO=y
CONFIG_COMPILER_WARNINGS_AS_ERRORS=y
CONFIG_INIT_STACKS=y
CONFIG_STACK_USAGE=y
CONFIG_EARLY_CONSOLE=y

# Stack Sizes
CONFIG_MAIN_STACK_SIZE=2048
# CONFIG_SHELL_STACK_SIZE=2048
# CONFIG_SYSTEM_WORKQUEUE_STACK_SIZE=3072
# CONFIG_LOG_PROCESS_THREAD_STACK_SIZE=4096
```

## boards/native_sim.conf
```kconfig
# I/O redirect
CONFIG_UART_NATIVE_PTY_0_ON_STDINOUT=y

# GPIO emulation
CONFIG_GPIO=y
CONFIG_GPIO_EMUL=y
```

## boards/b_u585i_iot02a.overlay
```dts
/ {
	aliases {
		pn532-uart = &usart3;
	};
};
```

## boards/native_sim.overlay
```dts
/ {
	uart1: uart_1 {
		status = "okay";
		compatible = "zephyr,native-tty-uart";
		current-speed = <115200>;
		serial-port = "/dev/ttyUSB0";
	};

	aliases {
		pn532-uart = &uart1;
	};
};
```

## src/main.c
```c
#include <zephyr/kernel.h>
#include <zephyr/device.h>
#include <zephyr/drivers/uart.h>
#include <zephyr/logging/log.h>
LOG_MODULE_REGISTER(main, LOG_LEVEL_DBG);

static const struct device *const uart_dev = DEVICE_DT_GET(DT_ALIAS(pn532_uart));

void pn532_uart_send(const uint8_t *data, size_t len)
{
    for (size_t i = 0; i < len; i++) {
        uart_poll_out(uart_dev, data[i]);
    }

    LOG_HEXDUMP_INF(data, len, "TX");
}

int pn532_uart_read(uint8_t *buf, size_t max_len, int timeout_ms)
{
    int64_t end = k_uptime_get() + timeout_ms;
    int64_t now = 0;
    size_t idx = 0;

    while (idx < max_len) {
        now = k_uptime_get();
        if (now >= end) {
            break;
        }

        uint8_t c;
        if (uart_poll_in(uart_dev, &c) == 0) {
            buf[idx++] = c;
        } else {
            k_yield();
        }
    }

    if (idx > 0) {
        LOG_HEXDUMP_INF(buf, idx, "RX");
    } else {
        LOG_WRN("RX timeout (%d ms)", timeout_ms);
    }

    return idx;
}

void pn532_uart_flush(void)
{
    uint8_t c;
    while (uart_poll_in(uart_dev, &c) == 0) {
        /* discard */
    }
}

bool pn532_is_ack(uint8_t *buf)
{
    const uint8_t ack[] = {0x00, 0x00, 0xFF, 0x00, 0xFF, 0x00};
    return memcmp(buf, ack, 6) == 0;
}

/* Send a bare ACK frame (host -> PN532) */
void pn532_send_ack(void)
{
    const uint8_t ack[] = {0x00, 0x00, 0xFF, 0x00, 0xFF, 0x00};
    pn532_uart_send(ack, sizeof(ack));
}

/* Change host-side baud rate at runtime */
static int set_host_baudrate(uint32_t baud)
{
    struct uart_config cfg = {0};
    int ret = uart_config_get(uart_dev, &cfg);
    if (ret) {
        LOG_ERR("uart_config_get failed: %d", ret);
        return ret;
    }
    cfg.baudrate = baud;
    ret = uart_configure(uart_dev, &cfg);
    if (ret) {
        LOG_ERR("uart_configure(%u) failed: %d", baud, ret);
    }
    return ret;
}

static bool send_command_get_ack(const uint8_t *cmd, size_t cmd_len, int timeout_ms)
{
    uint8_t buf[6];

    pn532_uart_send(cmd, cmd_len);

    int len = pn532_uart_read(buf, 6, timeout_ms);
    if (len != 6 || !pn532_is_ack(buf)) {
        LOG_ERR("No ACK");
        return false;
    }
    return true;
}

int main(void)
{
    uint8_t buf[64] = {0};
    int len = 0;

    if (!device_is_ready(uart_dev)) {
        LOG_ERR("UART not ready");
        return -1;
    }
    LOG_INF("UART ready (115200 baud)");

    /* ---- Wakeup ---- */
    uint8_t wakeup[] = {0x55, 0x55, 0x00, 0x00, 0x00};
    pn532_uart_send(wakeup, sizeof(wakeup));
    k_msleep(2);
    pn532_uart_flush();

    /* ---- SAMConfig ---- */
    uint8_t samconfig_cmd[] = {
        0x00, 0xFF, 0x05, 0xFB,
        0xD4, 0x14,
        0x01, 0x14, 0x01,
        0x02,
        0x00
    };

    if (!send_command_get_ack(samconfig_cmd, sizeof(samconfig_cmd), 200)) {
        LOG_ERR("SAMConfig: No ACK");
        return 0;
    }
    LOG_INF("SAMConfig ACK OK");

    memset(buf, 0, sizeof(buf));
    len = pn532_uart_read(buf, sizeof(buf), 300);
    if (len <= 0 || buf[6] != 0x15) {
        LOG_ERR("SAMConfig response failed");
        return 0;
    }
    LOG_INF("SAMConfig response OK");

    /* ---- SetSerialBaudRate to 921600 (BR=0x07) ----
     *
     * Frame: 00 FF 03 FD D4 10 07 15 00
     *   LEN=03, LCS=FD, TFI=D4, CMD=10, BR=07, DCS=15, Postamble=00
     */
    uint8_t set_baud_cmd[] = {
        0x00, 0xFF,
        0x03, 0xFD,
        0xD4, 0x10, 0x07,
        0x15,
        0x00
    };

    if (!send_command_get_ack(set_baud_cmd, sizeof(set_baud_cmd), 200)) {
        LOG_ERR("SetSerialBaudRate: No ACK");
        return 0;
    }
    LOG_INF("SetSerialBaudRate ACK OK");

    /* Read the D5 11 response — still at 115200 */
    memset(buf, 0, sizeof(buf));
    len = pn532_uart_read(buf, sizeof(buf), 200);
    if (len <= 0) {
        LOG_ERR("SetSerialBaudRate: No response");
        return 0;
    }
    LOG_INF("SetSerialBaudRate response OK");

    /* Per datasheet: PN532 switches AFTER receiving our ACK.
     * Send ACK at 115200, then switch host side. */
    pn532_send_ack();

    /* Wait >= 200 µs as required by the datasheet before next command */
    k_usleep(500);

    /* Switch host UART to 921600 */
    if (set_host_baudrate(921600) != 0) {
        return 0;
    }
    LOG_INF("Host UART switched to 921600");

    /* Flush any garbage from the baud-rate transition */
    k_msleep(2);
    pn532_uart_flush();

    /* ---- getFirmwareVersion ---- */
    uint8_t fw_cmd[] = {
        0x00, 0xFF, 0x02, 0xFE,
        0xD4, 0x02,
        0x2A,
        0x00
    };

    if (!send_command_get_ack(fw_cmd, sizeof(fw_cmd), 200)) {
        LOG_ERR("GetFirmwareVersion: No ACK");
        return 0;
    }
    LOG_INF("GetFirmwareVersion ACK OK");

    memset(buf, 0, sizeof(buf));
    len = pn532_uart_read(buf, sizeof(buf), 300);
    if (len <= 0) {
        LOG_ERR("GetFirmwareVersion: No response");
        return 0;
    }

    LOG_INF("Response received");
    LOG_INF("Found chip PN5%02X", buf[7]);
    LOG_INF("Firmware version: %d.%d", buf[8], buf[9]);

    while (1) {
        k_msleep(1000);
    }

    return 0;
}

void k_sys_fatal_error_handler(unsigned int reason, const struct arch_esf *esf)
{
	ARG_UNUSED(esf);
	struct k_thread *faulting_thread = NULL;

	switch (reason) {
	case K_ERR_CPU_EXCEPTION: {
		LOG_ERR("Generic CPU exception, not covered by other codes");
		break;
	}
	case K_ERR_SPURIOUS_IRQ: {
		LOG_ERR("Unhandled hardware interrupt");
		break;
	}
	case K_ERR_STACK_CHK_FAIL: {
		LOG_ERR("Faulting context overflowed its stack buffer");
		/* Get the current thread that caused the fault */
		faulting_thread = k_current_get();
		if (faulting_thread) {
			LOG_ERR("Fault occurred in thread: %s", k_thread_name_get(faulting_thread));
			LOG_ERR("Thread ID: %p", (void *)faulting_thread);
			LOG_ERR("Stack start: %p, size: %zu",
				(void *)faulting_thread->stack_info.start,
				faulting_thread->stack_info.size);
		} else {
			LOG_ERR("Could not determine faulting thread");
		}
		break;
	}
	case K_ERR_KERNEL_OOPS: {
		LOG_ERR("Moderate severity software error");
		break;
	}
	case K_ERR_KERNEL_PANIC: {
		LOG_ERR("High severity software error");
		break;
	}
	case K_ERR_ARCH_START: {
		LOG_ERR("Arch specific fatal errors");
		break;
	}
	default: {
		LOG_ERR("Unknow reason for fatal error (%d)", reason);
		break;
	}
	}

	/* Disable interrupts and halt the system */
	arch_irq_lock();
	for (;;) { /* Spin endlessly */ }
}
```

## src/pn532.c
```c
#include <zephyr/kernel.h>
#include <zephyr/device.h>
#include <zephyr/drivers/uart.h>
#include <zephyr/logging/log.h>
LOG_MODULE_REGISTER(pn532, LOG_LEVEL_DBG);

static void uart_send(const struct device *const uart_dev, uint8_t *data, size_t len)
{
    LOG_HEXDUMP_DBG(data, len, "TX");

    for (size_t i = 0; i < len; i++) {
        uart_poll_out(uart_dev, data[i]);
    }
}

static int uart_read(const struct device *const uart_dev, uint8_t *buf, size_t len, int timeout_ms)
{
    int64_t start = k_uptime_get();
    size_t received = 0;

    while (received < len) {
        if (uart_poll_in(uart_dev, &buf[received]) == 0) {
            received++;
        } else {
            if ((k_uptime_get() - start) > timeout_ms) {
                return -1;
            }
            k_msleep(1);
        }
    }

    LOG_HEXDUMP_DBG(buf, len, "RX");
    return 0;
}

static int uart_wait_data(const struct device *const uart_dev, int timeout_ms)
{
    int64_t start = k_uptime_get();
    uint8_t dummy;

    while ((k_uptime_get() - start) < timeout_ms) {
        if (uart_poll_in(uart_dev, &dummy) == 0) {
            /* put back into flow by returning success */
            return 0;
        }
        k_msleep(1);
    }

    return -1;
}

static size_t pn532_build_frame(uint8_t *cmd, uint8_t cmdlen, uint8_t *frame)
{
    uint8_t len = cmdlen + 1;
    uint8_t lcs = ~len + 1;

    uint8_t sum = 0;

    frame[0] = 0x00;
    frame[1] = 0x00;
    frame[2] = 0xFF;
    frame[3] = len;
    frame[4] = lcs;
    frame[5] = 0xD4;

    sum += 0xD4;

    for (uint8_t i = 0; i < cmdlen; i++) {
        frame[6 + i] = cmd[i];
        sum += cmd[i];
    }

    frame[6 + cmdlen] = ~sum + 1;
    frame[7 + cmdlen] = 0x00;

    return 8 + cmdlen;
}

static int pn532_send_cmd(const struct device *const uart_dev, uint8_t *cmd, uint8_t cmd_len,
                          uint8_t *resp, size_t resp_len)
{
    uint8_t frame[64];
    uint8_t ack[6];

    const uint8_t expected_ack[6] = {
        0x00, 0x00, 0xFF, 0x00, 0xFF, 0x00
    };

    /* 1. Build + send */
    size_t len = pn532_build_frame(cmd, cmd_len, frame);
    uart_send(uart_dev, frame, len);
    k_msleep(100);

    /* 2. Wait for data */
    if (uart_wait_data(uart_dev, 1000) != 0) {
        LOG_ERR("Timeout waiting for ACK");
        return -1;
    }

    /* 3. Read ACK */
    if (uart_read(uart_dev, ack, 6, 1000) != 0) {
        LOG_ERR("Failed to read ACK");
        return -1;
    }

    if (memcmp(ack, expected_ack, 6) != 0) {
        LOG_ERR("Invalid ACK");
        return -1;
    }

    /* 4. Wait for response */
    if (uart_wait_data(uart_dev, 1000) != 0) {
        LOG_ERR("Timeout waiting for response");
        return -1;
    }

    /* 5. Read response */
    if (uart_read(uart_dev, resp, resp_len, 1000) != 0) {
        LOG_ERR("Failed to read response");
        return -1;
    }

    return 0;
}

static uint32_t pn532_get_firmware_version(const struct device *const uart_dev)
{
    uint8_t cmd[] = {0x02};
    uint8_t resp[12] = {0};

    if (pn532_send_cmd(uart_dev, cmd, sizeof(cmd), resp, sizeof(resp)) != 0) {
        return 0;
    }

    /* Basic validation */
    if (!(resp[0] == 0x00 && resp[1] == 0x00 && resp[2] == 0xFF)) {
        LOG_ERR("Invalid response frame");
        return 0;
    }

    int offset = 7;

    uint32_t version = resp[offset++];
    version <<= 8;
    version |= resp[offset++];
    version <<= 8;
    version |= resp[offset++];
    version <<= 8;
    version |= resp[offset++];

    return version;
}
```

## src/pn532.h
```c
#ifndef PN532_H
#define PN532_H

#include <zephyr/device.h>

uint32_t pn532_get_firmware_version(const struct device *const uart_dev);

#endif /* PN532_H */
```

## src/test.c
```c
#include <zephyr/kernel.h>
#include <zephyr/device.h>
#include <zephyr/drivers/uart.h>
#include <zephyr/logging/log.h>
LOG_MODULE_REGISTER(test, LOG_LEVEL_INF);

static const struct device *uart_dev = DEVICE_DT_GET(DT_ALIAS(pn532_uart));

static uint8_t rx_buf[256] = {0};
static volatile size_t rx_len = 0;

static const uint8_t ack[] = {
    0x00, /* Preamble */
    0x00, /* Start code 1 */
    0xFF, /* Start code 2 */
    0x00, /* LEN  = 0 (no payload) */
    0xFF, /* LCS  = 0x100 - LEN = 0x100 - 0x00 = 0xFF */
    0x00  /* Postamble */
};

static const uint8_t wakeup_cmd[] = {
    0x55, /* Dummy byte (wakeup pattern, generates clock edges) */
    0x55, /* Dummy byte (ensures PN532 exits power-down) */
    0x00, /* Preamble (start of a "fake" frame) */
    0x00, /* Start code 1 */
    0x00  /* (Not a valid frame, just padding / noise) */
};

static const uint8_t SAMConfig_cmd[] = {
    0x00, /* Preamble */
    0xFF, /* Start code 1 */
    0x05, /* LEN = 5 bytes of payload (TFI + DATA) */
    0xFB, /* LCS = 0x100 - 0x05 = 0xFB */
    0xD4, /* TFI (Frame Identifier): D4 = Host → PN532 */
    0x14, /* Command: SAMConfiguration */
    0x01, /* Mode: 0x01 = Normal mode */
    0x14, /* Timeout: 0x14 = 20 (in units of 50 ms → 1 second) */
    0x01, /* IRQ usage: 0x01 = Use IRQ pin (optional depending on setup) */
    0x02, /* DCS (Data Checksum): Checksum of TFI + DATA: */
    0x00  /* Postamble */
};

static uint8_t GetFirmwareVersion_cmd[] = {
    0x00, /* Preamble */
    0xFF, /* Start code 1 */
    0x02, /* LEN = 2 bytes of payload (TFI + DATA) */
    0xFE, /* LCS = 0x100 - 0x02 = 0xFE */
    0xD4, /* TFI (Frame Identifier): D4 = Host → PN532 */
    0x02, /* Command: GetFirmwareVersion */
    0x2A, /* DCS (Data Checksum): Checksum of TFI + DATA */
    0x00  /* Postamble */
};

/* UART interrupt callback */
static void uart_cb(const struct device *dev, void *user_data)
{
    ARG_UNUSED(user_data);

    if (!uart_irq_update(dev)) {
        return;
    }

    if (uart_irq_rx_ready(dev)) {
        if (rx_len >= sizeof(rx_buf)) {
            LOG_ERR("RX buffer overflow");
            rx_len = 0;
            return;
        }
        int len = uart_fifo_read(dev, rx_buf + rx_len, sizeof(rx_buf) - rx_len);
        if (len > 0) {
            rx_len += len;
            LOG_HEXDUMP_INF(rx_buf, rx_len, "RX");
        }
    }
}

static void uart_send(const uint8_t *data, size_t len)
{
    for (size_t i = 0; i < len; i++) {
        uart_poll_out(uart_dev, data[i]);
    }

    LOG_HEXDUMP_INF(data, len, "TX");
}

static bool wait_for_rx(size_t expected_len, int timeout_ms)
{
    int64_t end = k_uptime_get() + timeout_ms;

    while (k_uptime_get() < end) {
        if (rx_len >= expected_len) {
            return true;
        }
        k_sleep(K_USEC(100));
    }

    return false;
}

static bool pn532_send_command(const uint8_t *cmd, size_t cmd_len)
{
    /* Reset RX buffer */
    rx_len = 0;

    /* Send command */
    uart_send(cmd, cmd_len);

    /* Wait for ACK (we’re willing to wait 200 ms for ack) */
    if (!wait_for_rx(sizeof(ack), 200)) {
        LOG_ERR("Timeout waiting for ACK");
        return false;
    }

    if (memcmp(rx_buf, ack, sizeof(ack)) != 0) {
        LOG_ERR("Invalid ACK");
        return false;
    }

    LOG_INF("ACK received");

    /* Did the response already start arriving right after ACK? */
    if (rx_len > sizeof(ack)) {
        return true;
    }

    /* Otherwise wait for more 300 ms */
    int64_t end = k_uptime_get() + 300;
    while (k_uptime_get() < end) {
        if (rx_len > sizeof(ack)) {
            LOG_INF("Response received");
            return true;
        }
        k_sleep(K_USEC(100));
    }

    LOG_ERR("Timeout waiting for response");
    return false;
}

int main(void)
{
    if (!device_is_ready(uart_dev)) {
        LOG_ERR("UART not ready");
        return 0;
    }

    LOG_INF("PN532 test started");

    uart_irq_callback_user_data_set(uart_dev, uart_cb, NULL);
    uart_irq_rx_enable(uart_dev);

    /* ---- Wakeup ---- */
    LOG_INF("Sending wakeup command");
    uart_send(wakeup_cmd, sizeof(wakeup_cmd));
#if !defined(CONFIG_BOARD_NATIVE_SIM)
    k_msleep(2);
#endif

    /* ---- SAMConfig ---- */
    LOG_INF("Sending SAMConfig command");
    if (!pn532_send_command(SAMConfig_cmd, sizeof(SAMConfig_cmd))) {
        LOG_ERR("SAMConfig failed");
        return 0;
    }
    /* Check SAMConfig response manually */
    size_t resp_offset = sizeof(ack);

    if (rx_len < resp_offset + 7) {
        LOG_ERR("SAMConfig response too short");
        return 0;
    }

    if (rx_buf[resp_offset + 6] != 0x15) {
        LOG_ERR("Invalid SAMConfig response: 0x%02X", rx_buf[resp_offset + 6]);
        return 0;
    }

    LOG_INF("SAMConfig OK");

    /* ---- GetFirmwareVersion ---- */
    LOG_INF("Sending GetFirmwareVersion");
    if (!pn532_send_command(GetFirmwareVersion_cmd, sizeof(GetFirmwareVersion_cmd))) {
        LOG_ERR("GetFirmwareVersion failed");
        return 0;
    }
    /* Parse firmware response manually */
    resp_offset = sizeof(ack);
    if (rx_len < resp_offset + 10) {
        LOG_ERR("Response too short");
        return 0;
    }
    if (rx_buf[resp_offset + 6] != 0x03) {
        LOG_ERR("Unexpected response code: 0x%02X", rx_buf[resp_offset + 6]);
        return 0;
    }
    const uint8_t ic  = rx_buf[resp_offset + 7];
    const uint8_t ver = rx_buf[resp_offset + 8];
    const uint8_t rev = rx_buf[resp_offset + 9];
    LOG_INF("Found PN5%02X", ic);
    LOG_INF("Firmware version: %d.%d", ver, rev);

    while (1) {
        k_sleep(K_SECONDS(1));
    }

    return 0;
}
```
